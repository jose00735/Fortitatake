## ftkos/buildroot-external/configs/ftkos_aarch64_defconfig
```kconfig
BR2_aarch64=y
BR2_cortex_a53=y
BR2_OPTIMIZE_S=y
BR2_TOOLCHAIN_BUILDROOT_MUSL=y
BR2_KERNEL_HEADERS_AS_KERNEL=y
BR2_PACKAGE_HOST_LINUX_HEADERS_CUSTOM_6_12=y
BR2_PER_PACKAGE_DIRECTORIES=y
BR2_CCACHE=y
BR2_CCACHE_DIR="$(HOME)/ftkos/ccache"
BR2_TARGET_GENERIC_HOSTNAME="ftkos"
BR2_TARGET_GENERIC_ISSUE="FortiTatake OS"
# BR2_TARGET_GENERIC_REMOUNT_ROOTFS_RW is not set
BR2_SYSTEM_DHCP=""
BR2_ROOTFS_OVERLAY="$(BR2_EXTERNAL_FTKOS_PATH)/board/ftkos/rootfs-overlay"
BR2_ROOTFS_POST_BUILD_SCRIPT="$(BR2_EXTERNAL_FTKOS_PATH)/board/ftkos/post-build.sh"
BR2_LINUX_KERNEL=y
BR2_LINUX_KERNEL_CUSTOM_VERSION=y
BR2_LINUX_KERNEL_CUSTOM_VERSION_VALUE="6.12"
BR2_LINUX_KERNEL_USE_CUSTOM_CONFIG=y
BR2_PACKAGE_BUSYBOX_CONFIG_FRAGMENT_FILES="$(BR2_EXTERNAL_FTKOS_PATH)/board/ftkos/busybox.fragment"
BR2_PACKAGE_IPROUTE2=y
BR2_PACKAGE_NFTABLES=y
BR2_PACKAGE_CONNTRACK_TOOLS=y
BR2_PACKAGE_TCPDUMP=y
BR2_PACKAGE_DNSMASQ=y
BR2_PACKAGE_MBEDTLS=y
BR2_PACKAGE_LIGHTTPD=y
BR2_PACKAGE_LIGHTTPD_MBEDTLS=y
BR2_PACKAGE_DROPBEAR=y
BR2_PACKAGE_LIBCURL=y
BR2_PACKAGE_LIBCURL_CURL=y
BR2_PACKAGE_LIBCURL_MBEDTLS=y
BR2_PACKAGE_MSTPD=y
BR2_PACKAGE_LLDPD=y
BR2_TARGET_ROOTFS_EROFS=y
BR2_TARGET_ROOTFS_EROFS_LZ4HC=y
# BR2_TARGET_ROOTFS_TAR is not set
BR2_LINUX_KERNEL_CUSTOM_CONFIG_FILE="$(BR2_EXTERNAL_FTKOS_PATH)/board/ftkos/linux-aarch64.config"
BR2_LINUX_KERNEL_IMAGE=y
# stage 4: FRR (OSPF and BGP for lab routers and FortiGates), started by the agent per namespace
BR2_PACKAGE_FRR=y
# BR2_PACKAGE_FRR_BFD is not set
```
